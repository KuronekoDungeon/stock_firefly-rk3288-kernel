## drivers/staging/ufsd/Kconfig
```kconfig
config UFSD_FS
	tristate "NTFS fs support (proprietary driver ufsd from Paragon pre-builded for ASUS)"
	help
	  This adds support for the NTFS file system via ufsd driver.

config UFSD_USE_NLS
	bool "Use kernel NLS instead of builtin UTF8"
	depends on UFSD_FS
	select NLS
	default n
	
choice
	prompt "Module and filesystem name"
	depends on UFSD_FS
	default UFSD_NAME_UFSD
	help
	  Select name of module and filesystem.

	config UFSD_NAME_UFSD
		bool "ufsd"
		help
		  Default name.

	config UFSD_NAME_TNTFS
		bool "tntfs"
		help
		  Tuxera NTFS.

	config UFSD_NAME_NTFS
		bool "ntfs" if !NTFS_FS
		help
		  NTFS.
		  conflicts with integrated ntfs driver.

endchoice

config UFSD_NAME
	string
	default "ufsd" if UFSD_NAME_UFSD
	default "tntfs" if UFSD_NAME_TNTFS
	default "ntfs" if UFSD_NAME_NTFS
```
